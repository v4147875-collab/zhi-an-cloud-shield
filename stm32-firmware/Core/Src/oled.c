#include "oled.h"
#include "stm32f1xx_hal.h"
#include <string.h>
#include <stdio.h>
/* 使用的 I2C handle 名称需与 oled.h 中声明一致 */
extern I2C_HandleTypeDef OLED_I2C_HANDLE;

/* SSD1306 控制字 */
static const uint8_t SSD1306_CMD = 0x00;
static const uint8_t SSD1306_DATA = 0x40;

/* 简化的发送命令/数据封装 */
static void ssd1306_write_cmd(uint8_t cmd) {
    uint8_t buf[2] = {SSD1306_CMD, cmd};
    HAL_I2C_Master_Transmit(&OLED_I2C_HANDLE, SSD1306_I2C_ADDR, buf, 2, 100);
}

static void ssd1306_write_data(uint8_t *data, uint16_t size) {
    const uint16_t chunk = 16;
    uint16_t sent = 0;
    while (sent < size) {
        uint16_t tosend = (size - sent) > chunk ? chunk : (size - sent);
        uint8_t buf[1 + chunk];
        buf[0] = SSD1306_DATA;
        memcpy(&buf[1], data + sent, tosend);
        HAL_I2C_Master_Transmit(&OLED_I2C_HANDLE, SSD1306_I2C_ADDR, buf, 1 + tosend, 100);
        sent += tosend;
    }
}

/* 基本初始化序列（适用于常见 SSD1306 128x64） */
void OLED_Init(void) {
    HAL_Delay(100);
    ssd1306_write_cmd(0xAE); // display off
    ssd1306_write_cmd(0xD5); ssd1306_write_cmd(0x80); // clock
    ssd1306_write_cmd(0xA8); ssd1306_write_cmd(0x3F); // multiplex 1/64
    ssd1306_write_cmd(0xD3); ssd1306_write_cmd(0x00); // display offset
    ssd1306_write_cmd(0x40); // start line
    ssd1306_write_cmd(0x8D); ssd1306_write_cmd(0x14); // charge pump
    ssd1306_write_cmd(0x20); ssd1306_write_cmd(0x00); // memory mode
    ssd1306_write_cmd(0xA1); // seg remap
    ssd1306_write_cmd(0xC8); // com scan dec
    ssd1306_write_cmd(0xDA); ssd1306_write_cmd(0x12); // com pins
    ssd1306_write_cmd(0x81); ssd1306_write_cmd(0xCF); // contrast
    ssd1306_write_cmd(0xD9); ssd1306_write_cmd(0xF1); // precharge
    ssd1306_write_cmd(0xDB); ssd1306_write_cmd(0x40); // vcom detect
    ssd1306_write_cmd(0xA4); // resume RAM display
    ssd1306_write_cmd(0xA6); // normal display
    ssd1306_write_cmd(0x2E); // deactivate scroll
    ssd1306_write_cmd(0xAF); // display on
    OLED_Clear();
}

/* 128x64 buffer 按 page(8 pixel) 存 */
static uint8_t oled_buffer[128 * 8];

void OLED_Clear(void) {
    memset(oled_buffer, 0x00, sizeof(oled_buffer));
    for (uint8_t page = 0; page < 8; page++) {
        ssd1306_write_cmd(0xB0 + page);
        ssd1306_write_cmd(0x00);
        ssd1306_write_cmd(0x10);
        ssd1306_write_data(&oled_buffer[page * 128], 128);
    }
}

/* ==================== 完整6x8 ASCII字库（32-127） ==================== */
static const uint8_t F6x8[][6] = {
    {0x00,0x00,0x00,0x00,0x00,0x00},// sp
    {0x00,0x00,0x00,0x2f,0x00,0x00},// !
    {0x00,0x00,0x07,0x00,0x07,0x00},// "
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    {0x00,0x08,0x04,0x08,0x10,0x08},// ~
};

/* 简单函数：在指定 page(y) 与列 x 显示 6x8 字符串 */
void OLED_ShowString(uint8_t x, uint8_t y, const char *str) {
    uint8_t col = x;
    uint8_t page = y;
    while (*str && col < 128) {
        char c = *str++;
        if (c < 0x20 || c > 0x7E) c = '?';
        uint8_t idx = (uint8_t)(c - 0x20);
        const uint8_t *p = F6x8[idx];
        if (page < 8) {
            memcpy(&oled_buffer[page * 128 + col], p, 6);
            col += 6;
        } else {
            break;
        }
    }
    for (uint8_t pg = page; pg <= page; pg++) {
        ssd1306_write_cmd(0xB0 + pg);
        ssd1306_write_cmd((uint8_t)(x & 0x0F));
        ssd1306_write_cmd((uint8_t)(0x10 | ((x >> 4) & 0x0F)));
        ssd1306_write_data(&oled_buffer[pg * 128], 128);
    }
}

/* 高级显示函数：显示 Init 状态 在第一行 */
void OLED_ShowInitState(OLED_InitState_t s) {
    OLED_ShowString(0, 0, "Init: ");
    if (s == OLED_INITING) {
        OLED_ShowString(48, 0, "Init...");
    } else if (s == OLED_OK) {
        OLED_ShowString(48, 0, "OK     ");
    } else {
        OLED_ShowString(48, 0, "ERROR  ");
    }
}

/* 显示 W5500 版本 在第二行 */
void OLED_ShowW5500Version(uint8_t ver) {
    char buf[16];
    snprintf(buf, sizeof(buf), "W5500:0x%02X", ver);
    OLED_ShowString(0, 1, buf);
}

/* 链接状态 在第三行 */
void OLED_ShowLinkState(OLED_LinkState_t s) {
    OLED_ShowString(0, 2, "Link: ");
    if (s == NET_LINK_UP) OLED_ShowString(48, 2, "LINK UP  ");
    else OLED_ShowString(48, 2, "LINK DOWN");
}

/* TCP 状态 在第四行 */
void OLED_ShowTCPState(OLED_TCPState_t s) {
    OLED_ShowString(0, 3, "TCP: ");
    if (s == TCP_WAITING) OLED_ShowString(48, 3, "Waiting... ");
    else OLED_ShowString(48, 3, "Connected  ");
}

/* 累计收发 在第五、六行 */
void OLED_UpdateStats(uint32_t rx_total, uint32_t tx_total) {
    char buf[20];
    snprintf(buf, sizeof(buf), "RX:%lu", (unsigned long)rx_total);
    OLED_ShowString(0, 4, buf);
    snprintf(buf, sizeof(buf), "TX:%lu", (unsigned long)tx_total);
    OLED_ShowString(0, 5, buf);
}